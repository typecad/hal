/* Auto-generated by @typecad/framework-zephyr from typecad-hal.config.ts. */
/* Enables peripherals the program uses. West merges this over the board DT. */

&i2c1 {
    status = "okay";
};

&wdt0 {
    status = "okay";
};

&adc {
    status = "okay";
};
