## demos/demo-st/src/dts/bindings/vnd,mipi-dbi-props.yaml
```yaml
description: "Display GPIO props carrier (no driver binds — see overlay.ts)"
compatible: "vnd,mipi-dbi-props"
include: base.yaml
properties:
  dc-gpios:
    type: phandle-array
  reset-gpios:
    type: phandle-array
  "#address-cells":
    type: int
  "#size-cells":
    type: int
```

## packages/framework-zephyr/hal/blackpill/out/dts/bindings/cuttlefish,spi-target.yaml
```yaml
description: |
  TypeCAD thin SPITarget (hal/spi-target.ts) — a raw spi_dt_spec
  peer. No driver binds this compatible; it exists so devicetree
  generation emits the spi properties (spi-max-frequency,
  spi-cpol/spi-cpha, reg = the cs-gpios index) that SPI_DT_SPEC_GET
  consumes from the generated C++.
compatible: "cuttlefish,spi-target"
include: spi-device.yaml
```

## packages/hal/tests/network/ble-diag/src/build/Kconfig/Kconfig.shield.defconfig
```kconfig
osource "C:/typecad/typecode/packages/hal/tests/network/ble-diag/src/boards/shields/*/Kconfig.defconfig"
```

## packages/hal/tests/network/ble-diag/src/build/Kconfig/arch/Kconfig
```kconfig
# Load Zephyr Arch Kconfig descriptions.
osource "C:/Users/justi/zephyrproject/zephyr/arch/rx/Kconfig"
osource "C:/Users/justi/zephyrproject/zephyr/arch/x86/Kconfig"
osource "C:/Users/justi/zephyrproject/zephyr/arch/xtensa/Kconfig"
osource "C:/Users/justi/zephyrproject/zephyr/arch/sparc/Kconfig"
osource "C:/Users/justi/zephyrproject/zephyr/arch/riscv/Kconfig"
osource "C:/Users/justi/zephyrproject/zephyr/arch/posix/Kconfig"
osource "C:/Users/justi/zephyrproject/zephyr/arch/openrisc/Kconfig"
osource "C:/Users/justi/zephyrproject/zephyr/arch/mips/Kconfig"
osource "C:/Users/justi/zephyrproject/zephyr/arch/arm64/Kconfig"
osource "C:/Users/justi/zephyrproject/zephyr/arch/arm/Kconfig"
osource "C:/Users/justi/zephyrproject/zephyr/arch/arc/Kconfig"
```

## packages/hal/tests/network/ble-diag/src/build/Kconfig/boards/Kconfig
```kconfig
# Load Zephyr board Kconfig descriptions.
osource "C:/Users/justi/zephyrproject/zephyr/boards/espressif/esp32s3_devkitc/Kconfig"
```

## packages/hal/tests/network/ble-diag/src/build/Kconfig/boards/Kconfig.defconfig
```kconfig
# Load Zephyr board defconfig descriptions.
osource "C:/Users/justi/zephyrproject/zephyr/boards/espressif/esp32s3_devkitc/Kconfig.defconfig"
```

## packages/hal/tests/network/ble-diag/src/build/Kconfig/boards/Kconfig.esp32s3_devkitc
```kconfig
# Load board Kconfig descriptions.
osource "C:/Users/justi/zephyrproject/zephyr/boards/espressif/esp32s3_devkitc/Kconfig.esp32s3_devkitc"
```

## tests/fixtures/display-bindings/dts/bindings/display/display-controller.yaml
```yaml
description: Common fields for display controllers.
properties:
  width:
    type: int
    required: true
  height:
    type: int
    required: true
```

## tests/fixtures/display-bindings/dts/bindings/display/ilitek,ili9341.yaml
```yaml
description: Ilitek ILI9341 display driver
compatible: "ilitek,ili9341"
include:
  - lcd-controller.yaml
  - name: mipi-dbi-spi-device.yaml
    property-blocklist:
      - te-delay
properties:
  rotation:
    type: int
    required: false
```

## tests/fixtures/display-bindings/dts/bindings/display/lcd-controller.yaml
```yaml
description: Common fields for LCD controllers driving a panel.
include: display-controller.yaml
properties:
  pixel-format:
    type: int
    required: true
    description: Initial pixel format (dt-bindings/display/panel.h).
```

## tests/fixtures/display-bindings/dts/bindings/display/mipi-dbi-spi-device.yaml
```yaml
description: Common fields for MIPI DBI devices using Mode C (SPI).
properties:
  mipi-max-frequency:
    type: int
    required: true
```

## tests/fixtures/display-bindings/dts/bindings/display/sitronix,st7796s.yaml
```yaml
description: Sitronix ST7796S Display controller
compatible: "sitronix,st7796s"
include: [mipi-dbi-spi-device.yaml, display-controller.yaml]
properties:
  pgc:
    type: uint8-array
    default: [0xF0, 0x09, 0x0B, 0x06]
    required: true
  ngc:
    type: uint8-array
    required: true
    default: [0xF0, 0x09]
  madctl:
    type: int
    default: 0x0
```

## tests/fixtures/display-bindings/dts/bindings/display/solomon,ssd1306-common.yaml
```yaml
description: Common properties for the Solomon SSD1306/SSD1309/SH1106 family
include: display-controller.yaml
properties:
  segment-offset:
    type: int
    required: true
  page-offset:
    type: int
    required: true
  display-offset:
    type: int
    required: true
  multiplex-ratio:
    type: int
    required: true
  prechargep:
    type: int
    required: true
  segment-remap:
    type: boolean
  com-invdir:
    type: boolean
```

## tests/fixtures/display-bindings/dts/bindings/display/solomon,ssd1306.yaml
```yaml
description: Solomon SSD1306 OLED (I2C variant)
compatible: "solomon,ssd1306"
include: ["solomon,ssd1306-common.yaml", "i2c-device.yaml"]
```

## tests/fixtures/display-bindings/dts/bindings/i2c/goodix,gt911.yaml
```yaml
description: Goodix GT911 capacitive touchscreen
compatible: "goodix,gt911"
include: [i2c-device.yaml]
properties:
  irq-gpios:
    type: phandle
    required: true
```

## tests/fixtures/display-bindings/dts/bindings/i2c/i2c-device.yaml
```yaml
description: Common I2C device properties.
properties:
  reg:
    type: int
    required: true
```

## tests/packages/framework-esp32/fixtures/handwritten-idf-project/sdkconfig.defaults
```kconfig
CONFIG_IDF_TARGET="esp32"
CONFIG_LOG_DEFAULT_LEVEL_INFO=y
CONFIG_FREERTOS_HZ=1000
```
